## boards/arm/MCU_Testbench/board.yml
```yaml
board:
  name: MCU_Testbench
  full_name: MCU Testbench Example 2026
  vendor: Formula Student Estonia
  socs:
    - name: stm32f767xx
```

## build/Kconfig/Kconfig.shield
```kconfig
osource "C:/Users/hendr/Desktop/Zephyr/zephyrproject/MCU_Testbench/boards/shields/*/Kconfig.shield"
```

## build/Kconfig/boards/Kconfig
```kconfig
# Load Zephyr board Kconfig descriptions.
osource "C:/Users/hendr/Desktop/Zephyr/zephyrproject/MCU_Testbench/boards/arm/MCU_Testbench/Kconfig"
```

## build/Kconfig/boards/Kconfig.MCU_Testbench
```kconfig
# Load board Kconfig descriptions.
osource "C:/Users/hendr/Desktop/Zephyr/zephyrproject/MCU_Testbench/boards/arm/MCU_Testbench/Kconfig.MCU_Testbench"
```

## build/Kconfig/boards/Kconfig.defconfig
```kconfig
# Load Zephyr board defconfig descriptions.
osource "C:/Users/hendr/Desktop/Zephyr/zephyrproject/MCU_Testbench/boards/arm/MCU_Testbench/Kconfig.defconfig"
```

## build/Kconfig/boards/Kconfig.sysbuild
```kconfig
# Load Sysbuild board Kconfig descriptions.
osource "C:/Users/hendr/Desktop/Zephyr/zephyrproject/MCU_Testbench/boards/arm/MCU_Testbench/Kconfig.sysbuild"
```
